## sketch/Filez/Backupz/bl808/packages/hashcat/Config.in
```kconfig
config BR2_PACKAGE_HASHCAT
    bool "hashcat"
    select BR2_TOOLCHAIN_BUILDROOT_GLIBC
```

## sketch/Filez/Backupz/bl808/packages/hcxdumptool/Config.in
```kconfig
config BR2_PACKAGE_HCXDUMPTOOL
    bool "hcxdumptool"
    select BR2_PACKAGE_LIBUSB
```
